## main/Kconfig.projbuild
```kconfig
menu "temp_mon_small_home Configuration"

    config ONE_WIRE_GPIO
        int "ONE WIRE GPIO number"
        range 0 48
        default 4
        help
            GPIO number to ONE WIRE.

    config BUTTON_GPIO
        int "Button GPIO number"
        range 0 48
        default 16
        help
            GPIO number (IOxx) connect button for select modes of temp show and enable BackLight of screen.

    config SCL_GPIO
        int "I2C SCL GPIO number"
        range 0 48
        default 22
        help
            GPIO number (IOxx) connect I2C SCL (for connect screen 1602 - for example).

    config SDA_GPIO
        int "I2C SDA GPIO number"
        range 0 48
        default 21
        help
            GPIO number (IOxx) connect I2C SDA (for connect screen 1602 - for example).

    config BACKLIGHT_TIMEOUT
        int "Backlight screen timeout in microseconds"
        range 0 3600000
        default 120000
        help
            When button press - screen enable backlight. After this timeout backlight will off.

    config FREEZE_AUTO_CHANGE_SHOW_TIMEOUT
        int "Freeze timeout for autochange temperature in microseconds"
        range 0 3600000
        default 40000
        help
            When button press - autochange show temp cycle (for all sensors) is freeze and show only current sensor. After this timeout auto cycle will be continue.

    config PERIOD_HOURS_SAVE_STAT_TO_FLASH
        int "Periods in hours, when save stat data to internal flash"
        range 1 24
        default 3
        help
            Programm collect temperature statistics and save it to internal flash (restore from flash at each device boot). For example if set 3 - then each 3 hour stat-data will be save to flash: 3, 6, 9 ... hours of time.

    config BLINK_GPIO
        int "Blink GPIO number"
        range 0 48
        default 8 if IDF_TARGET_ESP32C3 || IDF_TARGET_ESP32H2
        default 18 if IDF_TARGET_ESP32S2
        default 48 if IDF_TARGET_ESP32S3
        default 2
        help
            GPIO number (IOxx) to blink on and off or the RMT signal for the addressable LED.
            Some GPIOs are used for other purposes (flash connections, etc.) and cannot be used to blink.

    menu "WiFi configuration"

        config ESP_WIFI_SSID
            string "WiFi SSID"
            default "RT-GPON-61B0"
            help
          SSID (network name) for the example to connect to.

        config ESP_WIFI_PASSWORD
            string "WiFi Password"
            default "mypassword"
            help
          WiFi password (WPA or WPA2) for the example to use.

        choice WIFI_SCAN_METHOD
            prompt "WiFi Scan Method"
            default WIFI_SCAN_METHOD_ALL_CHANNEL
            help
                WiFi scan method:
         
                If "Fast" is selected, scan will end after find SSID match AP.
         
                If "All Channel" is selected, scan will end after scan all the channel.
         
            config WIFI_SCAN_METHOD_FAST
                bool "Fast"
            config WIFI_SCAN_METHOD_ALL_CHANNEL
                bool "All Channel"
        endchoice
         
        choice WIFI_CONNECT_AP_SORT_METHOD
          prompt "WiFi Connect AP Sort Method"
          default WIFI_CONNECT_AP_BY_SIGNAL
          help
            WiFi connect AP sort method:
         
            If "Signal" is selected, Sort matched APs in scan list by RSSI.
         
            If "Security" is selected, Sort matched APs in scan list by security mode.
         
          config WIFI_CONNECT_AP_BY_SIGNAL
            bool "Signal"
          config WIFI_CONNECT_AP_BY_SECURITY
            bool "Security"
        endchoice
         
        config WIFI_SCAN_RSSI_THRESHOLD
          int "WiFi minimum rssi"
          range -127 0
         
          default -127
          help
            The minimum rssi to accept in the scan mode.
         
        choice WIFI_SCAN_AUTH_MODE_THRESHOLD
          prompt "WiFi Scan auth mode threshold"
          default WIFI_AUTH_OPEN
          help
            The weakest authmode to accept in the scan mode.
         
          config WIFI_AUTH_OPEN
            bool "OPEN"
          config WIFI_AUTH_WEP
            bool "WEP"
          config WIFI_AUTH_WPA_PSK
            bool "WPA PSK"
          config WIFI_AUTH_WPA2_PSK
            bool "WPA2 PSK"
          config WIFI_AUTH_WPA_WPA2_PSK
            bool "WPA WPA2 PSK"
          config WIFI_AUTH_WPA2_ENTERPRISE
            bool "WPA2 ENTERPRISE"
          config WIFI_AUTH_WPA3_PSK
            bool "WPA3 PSK"
          config WIFI_AUTH_WPA2_WPA3_PSK
            bool "WPA2 WPA3 PSK"
          config WIFI_AUTH_WAPI_PSK
            bool "WAPI PSK"
        endchoice

        config SERVER_IP
            string "SERVER IPV4 Address"
            default "192.168.0.13"
            help
                SERVER IPV4 Address.
         
        config SERVER_PORT
            int "Server Port"
            range 0 65535
            default 80
            help
                The remote port.
         
        config CLIENT_PORT
            int "Client Port"
            range 0 65535
            default 4444
            help
                The local port.

        endmenu

endmenu
```
